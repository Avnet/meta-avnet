## conf/machine/zub1cg-sbc-base.conf
```bitbake
#@TYPE: Machine
#@NAME: zub1cg-sbc-base
#@DESCRIPTION: Machine support for ZUBoard_1CG 'Base' design.
#

MACHINEOVERRIDES =. "zub1cg-sbc-base:"
HDF_MACHINE = "zub1cg-sbc-base"
require conf/machine/include/zub1cg-sbc.inc
```

## conf/machine/zub1cg-sbc-dualcam.conf
```bitbake
#@TYPE: Machine
#@NAME: zub1cg-sbc-dualcam
#@DESCRIPTION: Machine support for ZUBoard_1CG 'Dualcam' design.
#

MACHINEOVERRIDES =. "zub1cg-sbc-dualcam:"
HDF_MACHINE = "zub1cg-sbc-dualcam"
require conf/machine/include/zub1cg-sbc.inc
```

## conf/machine/zub1cg-sbc-m2-wifi.conf
```bitbake
#@TYPE: Machine
#@NAME: zub1cg-sbc-m2-wifi
#@DESCRIPTION: Machine support for ZUBoard_1CG M.2 HSIO with Wifi/BT module design.
# (Laird Connectivity’s Sterling™-LWB+ WiFi 4 with Bluetooth 5.2 module)
#

MACHINEOVERRIDES = "zub1cg-sbc-base:${MACHINE}"
require conf/machine/include/zub1cg-sbc.inc

MACHINE_FEATURES += " wifi bluetooth"

DISTRO_FEATURES:append = " bluez5 dbus"
```

## conf/machine/zub1cg-sbc-trifecta.conf
```bitbake
#@TYPE: Machine
#@NAME: zub1cg-sbc-trifecta
#@DESCRIPTION: Machine support for ZUBoard_1CG 'trifecta' design.
#

MACHINEOVERRIDES =. "zub1cg-sbc-dualcam:zub1cg-sbc-trifecta:"
HDF_MACHINE = "zub1cg-sbc-trifecta"
require conf/machine/include/zub1cg-sbc.inc

MACHINE_FEATURES += " wifi bluetooth"
DISTRO_FEATURES:append = " bluez5 dbus"
```

## conf/machine/zub1cg-sbc.conf
```bitbake
#@TYPE: Machine
#@NAME: zub1cg-sbc
#@DESCRIPTION: Machine support for XBoardZU1.
#

MACHINEOVERRIDES = "zub1cg:zub1cg-zynqmp:${MACHINE}"

require conf/machine/include/soc-zynqmp.inc
require conf/machine/include/machine-xilinx-default.inc
require conf/machine/include/xilinx-board.inc

MACHINE_FEATURES = "rtc ext2 ext3 vfat usbhost usbgadget"

UBOOT_MACHINE = "xilinx_zynqmp_virt_defconfig"
# prevent U-Boot from deploying the boot.bin
SPL_BINARY = ""

SERIAL_CONSOLES ?= "115200;ttyPS0"

PMU_FIRMWARE_IMAGE_NAME ?= "pmu-firmware-zynqmp-pmu"
PMU_FIRMWARE_DEPLOY_DIR ?= "${TOPDIR}/pmutmp/deploy/images/zynqmp-pmu"

EXTRA_IMAGEDEPENDS += " \
		arm-trusted-firmware \
		virtual/bootloader \
		u-boot-zynq-scr \
		virtual/fsbl \
		virtual/pmu-firmware \
		avnet-boot-scr \
		"

# Used to create a wic image to boot from sd
IMAGE_BOOT_FILES = " \
                    boot.bin \
                    boot.scr \
                    fitImage;image.ub \
                    "

# deploy avnet-boot-scr scripts in images/linux/ folder
EXTRA_FILESLIST += " ${DEPLOY_DIR_IMAGE}/avnet-boot/:avnet-boot/ "

MACHINE_ESSENTIAL_EXTRA_RRECOMMENDS += "linux-firmware-wl18xx"

EXTRA_IMAGEDEPENDS_remove = "qemu-devicetrees"

DISTRO_FEATURES_append = " dbus"

PACKAGE_FEED_URIS = "http://petalinux.xilinx.com/sswreleases/sswboardfeeds/"
PACKAGE_FEED_BASE_PATHS = "zzsoc"
PACKAGE_FEED_ARCHS = "all aarch64 plnx_aarch64"
```

## recipes-core/images/avnet-image-minimal.wks
```
# short-description: Create EMMC image with a boot partition
# long-description: Creates a partitioned EMMC image. Boot files
# are located in the first vfat partition.

part /boot --source bootimg-partition --ondisk mmcblk0 --fstype=vfat --label boot --active --align 4 --reserved-size 1024M
part / --source rootfs --ondisk mmcblk0 --fstype=ext4 --label root --align 4
```
