## conf/distro/avnet.conf
```bitbake
DISTRO = "avnet"
DISTRO_CODENAME = "master"
DISTRO_NAME = "avnet (Yocto distro)"
DISTRO_VERSION = "${METADATA_DESCRIBE_LAYER_meta-avnet}"

DISTRO_FEATURES_BACKFILL_CONSIDERED = ""
DISTRO_FEATURES_DEFAULT = " \
    largefile \
    systemd \
    "

VIRTUAL-RUNTIME_init_manager = "systemd"

TARGET_VENDOR = "-avnet"

SDKPATHINSTALL = "/opt/${DISTRO}/${SDK_VERSION}"
SDK_NAME = "${DISTRO}-${TCLIBC}-${SDKMACHINE}-${IMAGE_BASENAME}-${TUNE_PKGARCH}-${MACHINE}"
SDK_VENDOR = "-avnet"

TCLIBCAPPEND = ""

require conf/distro/include/no-static-libs.inc
require conf/distro/include/yocto-uninative.inc
require conf/distro/include/security_flags.inc

INHERIT += "uninative"

BB_SIGNATURE_HANDLER ?= "OEEquivHash"
BB_HASHSERVE ??= "auto"
```

## conf/layer.conf
```bitbake
# We have a conf and classes directory, add to BBPATH
# Prepend to force yocto to use our conf files
BBPATH := "${LAYERDIR}:${BBPATH}"

# We have recipes-* directories, add to BBFILES
BBFILES += "${LAYERDIR}/recipes-*/*/*.bb \
	${LAYERDIR}/recipes-*/*/*.bbappend"

BBFILE_COLLECTIONS += "meta-avnet"
BBFILE_PATTERN_meta-avnet = "^${LAYERDIR}/"
BBFILE_PRIORITY_meta-avnet = "7"
LAYERSERIES_COMPAT_meta-avnet = "zeus"
```

## conf/machine/auboard15p-base.conf
```bitbake
#@TYPE: Machine
#@NAME: AUboard-15P-base
#@DESCRIPTION: Machine support for AUboard-15P 'Base' design.
#

require conf/machine/include/auboard15p-microblazeel.inc

MACHINEOVERRIDES =. "auboard15p-base:"
HDF_MACHINE = "auboard15p-base"
```

## conf/machine/include/auboard15p-microblazeel.inc
```bitbake
#@TYPE: Machine
#@NAME: AUboard-15P-microblazeel
#@DESCRIPTION: Machine configuration for the AUboard-15P board.

MACHINEOVERRIDES =. "auboard15p:auboard15p-microblazeel:"

# Variables that changes based on hw design or board specific requirement must be
# defined before calling the required inclusion file else pre-expansion value
# defined in microblazeel-generic.conf will be set.

# Yocto FS-Boot variables
YAML_SERIAL_CONSOLE_STDIN:pn-fs-boot ?= "axi_uartlite_0"
YAML_SERIAL_CONSOLE_STDOUT:pn-fs-boot ?= "axi_uartlite_0"
YAML_MAIN_MEMORY_CONFIG:pn-fs-boot ?= "DDR4_0"
YAML_FLASH_MEMORY_CONFIG:pn-fs-boot ?= "axi_quad_spi_0"
XSCTH_PROC:pn-fs-boot ?= "microblaze_0"

# Yocto device-tree variables
YAML_CONSOLE_DEVICE_CONFIG:pn-device-tree ?= "axi_uartlite_0"
YAML_MAIN_MEMORY_CONFIG:pn-device-tree ?= "DDR4_0"
DT_PADDING_SIZE:pn-device-tree ?= "0x1000"
DTC_FLAGS:pn-device-tree ?= ""
XSCTH_PROC:pn-device-tree ?= "microblaze_0"
YAML_DT_BOARD_FLAGS ?= "{BOARD template}"

# Yocto KERNEL Variables
UBOOT_ENTRYPOINT  ?= "0x80000000"
UBOOT_LOADADDRESS ?= "0x80000000"

# Set DDR Base address for u-boot-xlnx-scr variables
DDR_BASEADDR ?= "0x80000000"
SKIP_APPEND_BASEADDR ?= "0"

# auboard15p-microblazeel Serial Console
SERIAL_CONSOLES ?= "115200;ttyUL0"
YAML_SERIAL_CONSOLE_BAUDRATE ?= "115200"

# Required generic machine inclusion
require conf/machine/microblaze-generic.conf

# This machine conf file uses auboard15p-microblazeel xsa as reference input.
# User can override with auboard15p custom xsa using HDF_BASE and HDF_PATH variables
# from local.conf.
HDF_MACHINE = "auboard15p-microblazeel"

#### No additional settings should be after the Postamble
#### Postamble
PACKAGE_EXTRA_ARCHS:append = "${@['', 'auboard15p-microblazeel']['auboard15p-microblazeel' != '${MACHINE}']}"
```

## conf/machine/include/k24.inc
```bitbake
#@TYPE: Machine
#@NAME: k24
#@DESCRIPTION: Generic support for K24.
#

SOC_VARIANT = "eg"

MACHINEOVERRIDES =. "k24:"

require conf/machine/include/k24-sm.inc

EXTRA_IMAGEDEPENDS += " \
		arm-trusted-firmware \
		virtual/bootloader \
		u-boot-xlnx-scr \
		virtual/fsbl \
		virtual/pmu-firmware \
		avnet-boot-scr \
		"

# Used to create a wic image to boot from sd
IMAGE_BOOT_FILES = " \
                    boot.bin \
                    boot.scr \
                    fitImage;image.ub \
                    "

WKS_FILES = "petalinux-image-minimal.wks"

# deploy avnet-boot-scr scripts in images/linux/ folder
EXTRA_FILESLIST:append = " ${DEPLOY_DIR_IMAGE}/avnet-boot/:avnet-boot/ "

EXTRA_IMAGEDEPENDS:remove = "qemu-devicetrees"

DISTRO_FEATURES:append = " dbus"

PACKAGE_FEED_URIS = "http://petalinux.xilinx.com/sswreleases/sswboardfeeds/"
PACKAGE_FEED_BASE_PATHS = "zzsoc"
PACKAGE_FEED_ARCHS = "all aarch64 plnx_aarch64"
```

## conf/machine/include/pz-fmc2.inc
```bitbake
#@TYPE: Machine
#@NAME: pz-fmc2
#@DESCRIPTION: Generic support for Picozed with FMC2.
#

MACHINEOVERRIDES =. "pz:pz-fmc2:"

require conf/machine/include/soc-zynq.inc
require conf/machine/include/machine-xilinx-default.inc

MACHINE_FEATURES = "rtc ext2 ext3 vfat usbhost usbgadget"

EXTRA_IMAGEDEPENDS += "libyaml-native python3-cython-native python3-pyyaml-native"

UBOOT_MACHINE = "xilinx_zynq_virt_defconfig"

# prevent U-Boot from deploying the boot.bin
SPL_BINARY ?= ""

SERIAL_CONSOLES ?= "115200;ttyPS0"

MACHINE_ESSENTIAL_EXTRA_RDEPENDS += "device-tree"

EXTRA_IMAGEDEPENDS += " \
        virtual/bootloader \
        u-boot-xlnx-scr \
        virtual/fsbl \
        avnet-boot-scr \
        "

# Used to create a wic image to boot from emmc
IMAGE_BOOT_FILES = " \
                    boot.bin \
                    avnet-boot/avnet_mmc_ext4.scr;boot.scr \
                    fitImage;image.ub \
                    "

WKS_FILES = "petalinux-image-minimal.wks"

# deploy avnet-boot-scr scripts in images/linux/ folder
EXTRA_FILESLIST:append = " ${DEPLOY_DIR_IMAGE}/avnet-boot/:avnet-boot/ "
```

## conf/machine/include/zub1cg-sbc.inc
```bitbake
#@TYPE: Machine
#@NAME: zub1cg-sbc
#@DESCRIPTION: Generic support for ZUBoard_1CG SBC.
#

require conf/machine/zynqmp-generic.conf

MACHINEOVERRIDES =. "zub1cg:zub1cg-sbc:"
```

## conf/machine/k24-iocc-base.conf
```bitbake
#@TYPE: Machine
#@NAME: k24-iocc-base
#@DESCRIPTION: Machine support for K24 with IOCC 'Base' design.
#

MACHINEOVERRIDES =. "k24-iocc:k24-iocc-base:"
HDF_MACHINE = "k24-iocc-base"
require conf/machine/include/k24.inc
```

## conf/machine/k24-iocc-duo.conf
```bitbake
#@TYPE: Machine
#@NAME: k24-iocc-duo
#@DESCRIPTION: Machine support for K24 with IOCC 'Duo' design.
#

MACHINEOVERRIDES =. "k24-iocc:k24-iocc-duo:"
HDF_MACHINE = "k24-iocc-duo"
require conf/machine/include/k24.inc
```

## conf/machine/k24-iocc-factest.conf
```bitbake
#@TYPE: Machine
#@NAME: k24-iocc-factest
#@DESCRIPTION: Machine support for K24 with IOCC 'Factest' design.
#

MACHINEOVERRIDES =. "k24-iocc:k24-iocc-factest:"
HDF_MACHINE = "k24-iocc-factest"
require conf/machine/include/k24.inc
```

## conf/machine/mz7010-som-base.conf
```bitbake
#@TYPE: Machine
#@NAME: mz7010-som-base
#@DESCRIPTION: Machine support for Microzed 7010 SOM 'Base' design.
#

MACHINEOVERRIDES =. "mz7010-som:mz7010-som-base:"
HDF_MACHINE = "mz7010-som-base"
require conf/machine/include/mz-som.inc
```

## conf/machine/mz7020-som-base.conf
```bitbake
#@TYPE: Machine
#@NAME: mz7020-som-base
#@DESCRIPTION: Machine support for Microzed 7020 SOM 'Base' design.
#

MACHINEOVERRIDES =. "mz7020-som:mz7020-som-base:"
HDF_MACHINE = "mz7020-som-base"
require conf/machine/include/mz-som.inc
```

## conf/machine/pz7010-fmc2-base.conf
```bitbake
#@TYPE: Machine
#@NAME: pz7010-fmc2-base
#@DESCRIPTION: Machine support for Picozed 7010 with FMC2 'Base' design.
#

MACHINEOVERRIDES =. "pz7010-fmc2:pz7010-fmc2-base:"
HDF_MACHINE = "pz7010-fmc2-base"
require conf/machine/include/pz-fmc2.inc
```

## conf/machine/pz7015-fmc2-base.conf
```bitbake
#@TYPE: Machine
#@NAME: pz7015-fmc2-base
#@DESCRIPTION: Machine support for Picozed 7015 with FMC2 'Base' design.
#

MACHINEOVERRIDES =. "pz7015-fmc2:pz7015-fmc2-base:"
HDF_MACHINE = "pz7015-fmc2-base"
require conf/machine/include/pz-fmc2.inc
```

## conf/machine/pz7020-fmc2-base.conf
```bitbake
#@TYPE: Machine
#@NAME: pz7020-fmc2-base
#@DESCRIPTION: Machine support for Picozed 7020 with FMC2 'Base' design.
#

MACHINEOVERRIDES =. "pz7020-fmc2:pz7020-fmc2-base:"
HDF_MACHINE = "pz7020-fmc2-base"
require conf/machine/include/pz-fmc2.inc
```

## conf/machine/pz7030-fmc2-base.conf
```bitbake
#@TYPE: Machine
#@NAME: pz7030-fmc2-base
#@DESCRIPTION: Machine support for Picozed 7030 with FMC2 'Base' design.
#

MACHINEOVERRIDES =. "pz7030-fmc2:pz7030-fmc2-base:"
HDF_MACHINE = "pz7030-fmc2-base"
require conf/machine/include/pz-fmc2.inc
```

## conf/machine/u96v2-sbc-base.conf
```bitbake
#@TYPE: Machine
#@NAME: u96v2-sbc-base
#@DESCRIPTION: Machine support for Ultra96v2 'Base' design.
#

MACHINEOVERRIDES =. "u96v2-sbc-base:"
HDF_MACHINE = "u96v2-sbc-base"
require conf/machine/include/u96v2-sbc.inc
```

## conf/machine/u96v2-sbc-dualcam.conf
```bitbake
#@TYPE: Machine
#@NAME: u96v2-sbc-dualcam
#@DESCRIPTION: Machine support for Ultra96v2 'Dualcam' design.
#

MACHINEOVERRIDES =. "u96v2-sbc-dualcam:"
HDF_MACHINE = "u96v2-sbc-dualcam"
require conf/machine/include/u96v2-sbc.inc
```

## conf/machine/u96v2-sbc-factest.conf
```bitbake
#@TYPE: Machine
#@NAME: u96v2-sbc-factest
#@DESCRIPTION: Machine support for Ultra96v2 'Factest' design.
#

MACHINEOVERRIDES =. "u96v2-sbc-factest:"
HDF_MACHINE = "u96v2-sbc-factest"
require conf/machine/include/u96v2-sbc.inc
```

## conf/machine/uz3eg-iocc-base.conf
```bitbake
#@TYPE: Machine
#@NAME: uz3eg-iocc-base
#@DESCRIPTION: Machine support for UltraZed-EG with IOCC 'Base' design.
#

MACHINEOVERRIDES =. "uz3eg-iocc:uz3eg-iocc-base:"
HDF_MACHINE = "uz3eg-iocc-base"
require conf/machine/include/uz3eg.inc
```

## conf/machine/uz3eg-pciec-base.conf
```bitbake
#@TYPE: Machine
#@NAME: uz3eg-pciec-base
#@DESCRIPTION: Machine support for UltraZed-EG with PCIEC 'Base' design.
#

MACHINEOVERRIDES =. "uz3eg-pciec:uz3eg-pciec-base:"
HDF_MACHINE = "uz3eg-pciec-base"
require conf/machine/include/uz3eg.inc
```

## conf/machine/uz7ev-evcc-base.conf
```bitbake
#@TYPE: Machine
#@NAME: uz7ev-evcc-base
#@DESCRIPTION: Machine support for UltraZed-EV with EVCC 'Base' design.
#

MACHINEOVERRIDES =. "uz7ev-evcc-base:"
HDF_MACHINE = "uz7ev-evcc-base"
CONFIG_SUBSYSTEM_ETHERNET_PSU_ETHERNET_3_MAC=""
require conf/machine/include/uz7ev-evcc.inc
```

## conf/machine/uz7ev-evcc-hdmi-v.conf
```bitbake
#@TYPE: Machine
#@NAME: uz7ev-evcc-hdmi-v
#@DESCRIPTION: Machine support for UltraZed-EV with EVCC, including HDMI and VCU support.
#

MACHINEOVERRIDES =. "uz7ev-evcc-hdmi:uz7ev-evcc-hdmi-v:"
HDF_MACHINE = "uz7ev-evcc-hdmi-v"
require conf/machine/include/uz7ev-evcc.inc
```

## conf/machine/uz7ev-evcc-hdmi.conf
```bitbake
#@TYPE: Machine
#@NAME: uz7ev-evcc-hdmi
#@DESCRIPTION: Machine support for UltraZed-EV with EVCC, including HDMI support.
#

MACHINEOVERRIDES =. "uz7ev-evcc-hdmi:"
HDF_MACHINE = "uz7ev-evcc-hdmi"
require conf/machine/include/uz7ev-evcc.inc
```

## conf/machine/uz7ev-evcc-nvme.conf
```bitbake
#@TYPE: Machine
#@NAME: uz7ev-evcc-nvme
#@DESCRIPTION: Machine support for UltraZed-EV with EVCC, including Opsero FPGADrive support.
#

MACHINEOVERRIDES =. "uz7ev-evcc-nvme:"
HDF_MACHINE = "uz7ev-evcc-nvme"
require conf/machine/include/uz7ev-evcc.inc
```
